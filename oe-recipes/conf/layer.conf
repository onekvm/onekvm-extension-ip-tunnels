## oe-recipes/conf/layer.conf
```bitbake
BBPATH .= ":${LAYERDIR}"
BBFILES += "${LAYERDIR}/recipes-*/*/*.bb ${LAYERDIR}/recipes-*/*/*.bbappend"
BBFILE_COLLECTIONS += "onekvm-extension-ip-tunnels"
BBFILE_PATTERN_onekvm-extension-ip-tunnels := "^${LAYERDIR}/"
BBFILE_PRIORITY_onekvm-extension-ip-tunnels = "8"
LAYERDEPENDS_onekvm-extension-ip-tunnels = "core onekvm"
LAYERSERIES_COMPAT_onekvm-extension-ip-tunnels = "wrynose"
```
